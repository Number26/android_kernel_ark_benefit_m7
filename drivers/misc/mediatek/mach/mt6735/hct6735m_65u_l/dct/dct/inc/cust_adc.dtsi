/*
 * Generated by MTK SP Drv_CodeGen Version 03.13.6  for MT6735M. Copyright MediaTek Inc. (C) 2013.
 * Sun Mar  6 16:47:16 2016
 * Do Not Modify the File.
 */

/********************************************
 *ADC DTSI File
********************************************/

AUXADC@0x0 {
	compatible = "mediatek, AUXADC";
	reg=<0x0, 0x1000>;
	interrupts = <0 0 0x0>;
	TEMPERATURE=<0>;
	TEMPERATURE1=<1>;
	ADC_FDD_RF_PARAMS_DYNAMIC_CUSTOM_CH=<2>;
	clocks = <& >;
	clocks = "auxadc-main";
};
