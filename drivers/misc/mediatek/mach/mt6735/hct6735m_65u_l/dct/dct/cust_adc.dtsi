/*
 * Generated by MTK SP DrvGen Version 03.13.6 for MT6735M. Copyright MediaTek Inc. (C) 2013.
 * Sun Mar 06 16:57:00 2016
 * Do Not Modify the File.
 */

/********************************************
 *ADC DTSI File
********************************************/

AUXADC@ {
	compatible = "mediatek, AUXADC";
	reg=<, 0x1000>;
	interrupts = <0 0 0x0>;
	TEMPERATURE=<0>;
	TEMPERATURE1=<1>;
	ADC_FDD_RF_PARAMS_DYNAMIC_CUSTOM_CH=<2>;
	clocks = <& >;
	clock-names = "auxadc-main";
};
